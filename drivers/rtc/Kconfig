## drivers/rtc/Kconfig
```kconfig
# Copyright (c) 2022 Bjarki Arge Andreasen
# SPDX-License-Identifier: Apache-2.0

config RTC
	bool "RTC driver support"

if RTC

source "drivers/rtc/Kconfig.rtc_emul"

endif
```

## drivers/rtc/Kconfig.rtc_emul
```kconfig
# Copyright (c) 2022 Bjarki Arge Andreasen
# SPDX-License-Identifier: Apache-2.0

config RTC_EMUL
	bool "Emulated RTC driver"
```

## drivers/rtcc/Kconfig
```kconfig
# Copyright (c) 2022 Bjarki Arge Andreasen
# SPDX-License-Identifier: Apache-2.0

config RTCC
	bool "RTCC driver support"

if RTCC

source "drivers/rtcc/Kconfig.rtcc_emul"

source "drivers/rtcc/Kconfig.rtcc_atmel_sam"

endif
```

## drivers/rtcc/Kconfig.rtcc_atmel_sam
```kconfig
# Copyright (c) 2022 Bjarki Arge Andreasen
# SPDX-License-Identifier: Apache-2.0

config RTCC_ATMEL_SAM
	bool "RTCC (RTC) driver for the ATMEL SAM family"
	help
	  Tested on ATSAM4E16C
```

## drivers/rtcc/Kconfig.rtcc_emul
```kconfig
# Copyright (c) 2022 Bjarki Arge Andreasen
# SPDX-License-Identifier: Apache-2.0

config RTCC_EMUL
	bool "Emulated RTCC driver"
```

## dts/bindings/rtc/rtc-device.yaml
```yaml
# Copyright (c) 2022 Bjarki Arge Andreasen
# SPDX-License-Identifier: Apache-2.0

include: base.yaml

description: RTC device common bindings

properties:
  alarms-count:
    type: int
    default: 0
    description: |
      Number of alarms supported by RTCC device
```

## dts/bindings/rtcc/atmel,sam-rtcc.yaml
```yaml
# Copyright (c) 2022 Bjarki Arge Andreasen
# SPDX-License-Identifier: Apache-2.0

description: Atmel SAM family RTCC device

compatible: "atmel,sam-rtcc"

include: rtcc-device.yaml

properties:
  reg:
    required: true

  wp-reg:
    type: int
    description: Address of write protection mode register (WPMR)
    required: true

  interrupts:
    required: true

  peripheral-id:
    type: int
    description: peripheral ID
    required: true

  alarms-count:
    default: 1

  timestamps-count:
    default: 0
```

## dts/bindings/rtcc/rtcc-device.yaml
```yaml
# Copyright (c) 2022 Bjarki Arge Andreasen
# SPDX-License-Identifier: Apache-2.0

include: base.yaml

description: RTCC device common bindings

properties:
  alarms-count:
    type: int
    description: |
      Number of alarms supported by RTCC device

  timestamps-count:
    type: int
    description: |
      Number of timestamps supported by RTCC device
```

## dts/bindings/rtcc/zephyr,rtcc-emul.yaml
```yaml
# Copyright (c) 2022 Bjarki Arge Andreasen
# SPDX-License-Identifier: Apache-2.0

description: Emulated RTCC device

compatible: "zephyr,rtcc-emul"

include: rtcc-device.yaml

properties:
  alarms-count:
    required: true

  timestamps-count:
    default: 0
```

## tests/drivers/rtcc/rtcc_api/testcase.yaml
```yaml
# Copyright (c) 2022 Bjarki Arge Andreasen
# SPDX-License-Identifier: Apache-2.0

tests:
  drivers.rtcc.rtcc_api:
    tags: drivers rtcc api userspace
    filter: dt_alias_exists("rtcc")
    depends_on: rtcc
```
