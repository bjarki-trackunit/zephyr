/*
 * Copyright 2024 NXP
 *
 * SPDX-License-Identifier: Apache-2.0
 */

/ {
	aliases {
		gnss = &gnss;
	};
};

&lpuart3 {
	status = "okay";
	current-speed = <115200>;

	gnss: u_blox_m10 {
		status = "okay";
		compatible = "u-blox,m10";
		uart-baudrate = <115200>;
	};
};
